// SPDX-FileCopyrightText: 2024 IObundle
//
// SPDX-License-Identifier: MIT

/* Copyright (c) 2024 IObundle */

/dts-v1/;

/ {
    #address-cells = <1>;
    #size-cells = <1>;
    model = "IOb-SoC, VexRiscv";
    compatible = "IOb-SoC, VexRiscv";
    // CPU
    // Memory
    // Choosen
    soc {
        #address-cells = <1>;
        #size-cells = <1>;
        compatible = "iobundle,iob-soc", "simple-bus";
        ranges;

        // Other SOC peripherals go here

        // Add this Node to the device tree
        AXISTREAMIN0: axistream_in@/*AXISTREAMIN0_ADDR_MACRO*/ {
            compatible = "iobundle,axistream_in0";
            reg = <0x/*AXISTREAMIN0_ADDR_MACRO*/ 0x20>;
        };

    };
};
